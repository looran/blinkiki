/ {
	/* enable ADC */
        zephyr,user {
                io-channels = <&adc0 6>;
        };
};

&adc0 {
        #address-cells = <1>;
        #size-cells = <0>;

	status = "okay";
        channel@6 {
                reg = <6>;
                zephyr,gain = "ADC_GAIN_1_4";
                zephyr,reference = "ADC_REF_INTERNAL";
                zephyr,acquisition-time = <ADC_ACQ_TIME_DEFAULT>;
                zephyr,resolution = <12>; 
        };
};

//&dma {
//	status = "okay";
//};

//&psram0 {
//       //reg = <0x3c000000 DT_SIZE_M(2)>;
//       status = "okay";
//};
